## sdkconfig.defaults
```kconfig
# ESP32-C3 Configuration
CONFIG_IDF_TARGET="esp32c3"

# TWAI (CAN) Configuration
CONFIG_TWAI_ISR_IN_IRAM=y

# FreeRTOS Configuration
CONFIG_FREERTOS_HZ=1000
CONFIG_FREERTOS_TIMER_TASK_STACK_DEPTH=4096

# Main task stack size
CONFIG_ESP_MAIN_TASK_STACK_SIZE=4096

# I2C Configuration
CONFIG_I2C_ENABLE_DEBUG_LOG=n

# Logging
CONFIG_LOG_DEFAULT_LEVEL_INFO=y
CONFIG_LOG_MAXIMUM_LEVEL_DEBUG=y

# Watchdog
CONFIG_ESP_TASK_WDT=y
CONFIG_ESP_TASK_WDT_TIMEOUT_S=10
```
